## drivers/kernelsu/Kconfig
```kconfig
menu "KernelSU"

config KSU
	tristate "KernelSU function support"
	default y
	help
	  Enable kernel-level root privileges on Android System.
	  Requires CONFIG_KPROBES for kernel hooking support.
	  To compile as a module, choose M here: the
	  module will be called kernelsu.

config KSU_DEBUG
	bool "KernelSU debug mode"
	depends on KSU
	default n
	help
	  Enable KernelSU debug mode.

config KSU_DISABLE_MANAGER
	bool "Disable KernelSU manager integration"
	depends on KSU
	default n
	help
	  Disable manager APK detection and manager-specific handling.
	  Root will be used in place of manager-only functionality.

config KSU_DISABLE_POLICY
	bool "Disable KernelSU policy profiles"
	depends on KSU
	default n
	help
	  Disable per-app root/non-root profile customization.
	  Escalation will always use the default full root profile, and
	  non-root handling will follow the global umount policy only.

config KSU_ALLOWLIST_WORKAROUND
	bool "KernelSU allowlist workaround"
	depends on KSU
	default n
	help
	  Enable workaround for broken allowlist save

config KSU_ADB_ROOT_DEFAULT
	bool "Enable adb_root by default at boot"
	depends on KSU
	default y
	help
	  Turn the adb_root feature on during kernelsu_init instead of waiting
	  for the manager to flip it at runtime.

	  This is needed on devices where adbd is exec'd from early userspace,
	  long before the KernelSU manager ever runs. adb_root is a static_key,
	  and static keys do not survive a reboot, so without this the execve
	  hook is a no-op on every fresh boot and `adb shell` stays unprivileged
	  until someone opens the manager and toggles the switch by hand.

	  Leave this off if you prefer to control adb_root from the manager UI
	  only. It is equivalent to passing force_feature=adb_root:1 on the
	  kernel command line, but does not require editing the DTB.

# For easier extern ifdef handling
config KSU_MANUAL_HOOK
	bool "KernelSU manual hook mode."
	depends on KSU && KSU != m
	default y if !KPROBES
	default n
	help
	  Enable manual hook support.

choice
	prompt "KernelSU dynamic hook mode"
	depends on KSU && !KSU_MANUAL_HOOK
	default KSU_KPROBES_HOOK

config KSU_KPROBES_HOOK
	bool "KernelSU tracepoint+kretprobe hook"
	depends on KRETPROBES && KPROBES && HAVE_SYSCALL_TRACEPOINTS
	help
	  Enable KPROBES, KRETPROBES and TRACEPOINT hook for KernelSU core.
	  This should not be used on kernel below 5.10.

config KSU_SYSCALL_TABLE_HOOK
	bool "KernelSU syscall table patching hook"
	depends on ARM64 || X86_64
	help
	  Patch sys_call_table entries directly to hook syscalls without
	  kprobes or tracepoints. Intended for non-GKI kernels where kprobes
	  are unavailable or non-functional.
	  Requires kernel >= 4.17 (pt_regs-based syscall ABI).

endchoice

endmenu
```
